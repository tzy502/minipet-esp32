## Firmware/board216/main/Kconfig.projbuild
```kconfig
menu "MiniPet 固件配置"

config MP_BUBBLE_ENABLE
    bool "对话气泡层（E12 台词/配对码/OTA 提示）"
    default n
    help
      用户口径 2026-10-01：「整体去除气泡 效果不好」→ 默认关闭（与 1.85B 同口径）：
      屏上不再出现任何对话气泡（state_machine 的气泡包装函数整段不画）。
      配对码 MP_CMD_PAIRING_CODE 已改走顶部常驻横幅，关气泡不影响配对。
      置 y 可整体恢复（回退对照用）。

config MP_ASSET_HEAP_GATE_KB
    int "素材绑定内部堆门（KB）"
    default 24
    help
      fopen/fread TF 素材包前要求的最低内部堆空闲（state_machine 绑定门
      heap_ok_for_asset_load 与 asset_dl FONT px 读取门共用，防低堆期
      newlib 锁分配失败 abort）。默认 24KB = AMOLED-2.16 板既有保护值
      （行为不变）。

config MINIPET_DEFAULT_SRV_URL
    string "默认服务器地址（NVS srv_url 为空时的兜底）"
    default ""
    help
        设备从 NVS 读服务器地址（配网页写入）。该键为空时（首次上电 / NVS 被清 /
        未配网）用本项作为兜底，避免"WiFi 已连上、却不知道服务器在哪"而永远不上线
        （真机实测：srv_url 丢失后设备静默卡在 OFFLINE，日志里连一条 hello 都没有）。

        留空 = 旧行为：必须先在配网页里填写服务器地址。

        例：http://192.168.1.10:38090

        注意：配网页写入的值始终优先，本项只在 NVS 为空时生效。

endmenu
```

## Firmware/main/Kconfig.projbuild
```kconfig
menu "MiniPet 固件配置"

choice MP_BOARD
    prompt "目标板型"
    default MP_BOARD_AMOLED216
    help
      选择编译目标的硬件板型。板型决定：profiles 的引脚表/能力位
      （MINIPET_ACTIVE_PROFILE）、显示驱动（CO5300 vs ST77916）。
      旧板构建（AMOLED-2.16）是默认值，一切行为不变。

config MP_BOARD_AMOLED216
    bool "Waveshare ESP32-S3-Touch-AMOLED-2.16（480x480 AMOLED CO5300）"

config MP_BOARD_LCD185B
    bool "Waveshare ESP32-S3-Touch-LCD-1.85B（360x360 圆 LCD ST77916）"
endchoice

config MP_LCD_PCLK_HZ
    int "LCD QSPI 时钟（Hz，仅 MP_BOARD_LCD185B）"
    default 40000000
    range 1000000 80000000
    help
      ST77916 面板 QSPI 时钟。花屏 bring-up 期先降 20MHz 排除信号完整性；
      确认后调回 40MHz。

config MP_LCD_CONTINUOUS_REFRESH
    bool "持续全帧刷新（1.85B RAMless 面板必需；关=一次性写入模式）"
    depends on MP_BOARD_LCD185B
    default y

config MP_LCD_BRINGUP_TEST
    bool "开机全屏色块自检（红→绿→蓝，1.85B bring-up 用，验收后关闭）"
    default n
    help
      display_init 末尾连推三张全屏纯色（各 ~0.7s），与渲染管线完全解耦：
      颜色正确=传输/像素格式通，花屏=格式/线序问题，不亮=背光/复位问题。

config MP_ASSET_HEAP_GATE_KB
    int "素材绑定内部堆门（KB）"
    default 24
    help
      fopen/fread TF 素材包前要求的最低内部堆空闲（state_machine 绑定门
      heap_ok_for_asset_load 与 asset_dl FONT px 读取门共用，防低堆期
      newlib 锁分配失败 abort）。一套代码、板级配置：默认 24KB =
      AMOLED-2.16 板既有保护值（行为不变）；内部堆紧张的 1.85B 板在
      sdkconfig.185b 单独调低（实测绑定成功且多轮启动零 abort 的安全值，
      见该文件 CONFIG_MP_ASSET_HEAP_GATE_KB）。

config MINIPET_DEFAULT_SRV_URL
    string "默认服务器地址（NVS srv_url 为空时的兜底）"
    default ""
    help
        设备从 NVS 读服务器地址（配网页写入）。该键为空时（首次上电 / NVS 被清 /
        未配网）用本项作为兜底，避免"WiFi 已连上、却不知道服务器在哪"而永远不上线
        （真机实测：srv_url 丢失后设备静默卡在 OFFLINE，日志里连一条 hello 都没有）。

        留空 = 旧行为：必须先在配网页里填写服务器地址。

        例：http://192.168.1.10:38090

        注意：配网页写入的值始终优先，本项只在 NVS 为空时生效。

endmenu
```

## Firmware/sdkconfig.defaults.amoled185b
```kconfig
# LCD-1.85B 板构建默认值（与 sdkconfig.defaults 叠加使用）：
#   idf.py -B build-185b -DSDKCONFIG=sdkconfig.185b \
#          -DSDKCONFIG_DEFAULTS="sdkconfig.defaults;sdkconfig.defaults.amoled185b" build
# 独立 sdkconfig/构建目录 → 默认（build/，AMOLED-2.16）构建完全不受影响。
CONFIG_MP_BOARD_LCD185B=y
```
